## gateway/sdkconfig.defaults
```kconfig
CONFIG_ESP_WIFI_MODE_STA=y
CONFIG_ESP_DEFAULT_CPU_FREQ_MHZ_240=y
CONFIG_FREERTOS_HZ=1000
CONFIG_ESP_WIFI_SOFTAP_SUPPORT=y
CONFIG_HTTPD_MAX_REQ_HDR_LEN=1024
CONFIG_LWIP_MAX_SOCKETS=16
CONFIG_ESP_WIFI_NVS_ENABLED=y
CONFIG_FATFS_LFN_HEAP=y
CONFIG_FATFS_MAX_LFN=255
```

## node/sdkconfig.defaults
```kconfig
CONFIG_ESP_WIFI_MODE_STA=y
CONFIG_ESPNOW_ENABLE_LONG_RANGE=n
CONFIG_ESP_DEFAULT_CPU_FREQ_MHZ_240=y
CONFIG_FREERTOS_HZ=1000
CONFIG_ESP_WIFI_SOFTAP_SUPPORT=y
CONFIG_ESP_WIFI_NVS_ENABLED=y
CONFIG_LWIP_ESP_GRATUITOUS_ARP=y
```
